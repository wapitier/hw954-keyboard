## boards/shields/hw954_radio/Kconfig.defconfig
```kconfig
if SHIELD_HW954_SENDER || SHIELD_HW954_RECEIVER

config ZMK_KEYBOARD_NAME
    default "HW954 Radio"

config ZMK_SPLIT
    default y

endif

if SHIELD_HW954_RECEIVER

config ZMK_SPLIT_ROLE_CENTRAL
    default y

config ZMK_SPLIT_BLE_CENTRAL_PERIPHERALS
    default 1

endif
```

## boards/shields/hw954_radio/Kconfig.shield
```kconfig
config SHIELD_HW954_SENDER
    def_bool $(shields_list_contains,hw954_sender)

config SHIELD_HW954_RECEIVER
    def_bool $(shields_list_contains,hw954_receiver)
```

## boards/shields/hw954_test/Kconfig.defconfig
```kconfig
if SHIELD_HW954_TEST

config ZMK_KEYBOARD_NAME
    default "HW954 USB Test"

endif
```
